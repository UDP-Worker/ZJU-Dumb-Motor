#include "servo.h"
#include "main.h"
#include "beep.h"
#include "ultrasonic.h"
#include "config.h"

extern TIM_HandleTypeDef htim5;

static uint16_t pwm_period = 0;

void Servo_Init(void)
{
    pwm_period = htim5.Init.Period;
    HAL_TIM_PWM_Start(&htim5, TIM_CHANNEL_1);
}

void Servo_SetAngle(float angle)
{
    /*
     * The mechanical installation of the servo used in the "Dumb-Motor"
     * project is such that 100° corresponds to the forward direction,
     * 180° is the extreme left and 20° is the extreme right.  Therefore
     * we remap the logical angle range [20°, 180°] to the PWM duty cycle
     * required by the servo.  The PWM generated by TIM5 has a period of
     * 20 ms (50 Hz) with a compare value of 249 giving ~0.5 ms pulse and
     * 1249 giving ~2.0 ms pulse.  We linearly map 20° to 0.5 ms and
     * 180° to 2.0 ms so that 100° becomes the new centre position.
     */

    if (angle < SERVO_RIGHT_BOUNDARY) angle = SERVO_RIGHT_BOUNDARY;
    if (angle > SERVO_LEFT_BOUNDARY)  angle = SERVO_LEFT_BOUNDARY;

    float scaled = (angle - SERVO_RIGHT_BOUNDARY) /
                   (SERVO_LEFT_BOUNDARY - SERVO_RIGHT_BOUNDARY);          /* 0.0 .. 1.0  */
    uint32_t compare = (uint32_t)(scaled * 1000.0f + 249.0f);
    __HAL_TIM_SET_COMPARE(&htim5, TIM_CHANNEL_1, compare);

}

/*
 * Simplified sweeping logic: only measure at centre, left and right
 * extremes.  The servo cycles through the three positions and triggers
 * one ultrasonic measurement at each position.
 */
static uint8_t sweep_state = 0; /* 0 -> centre, 1 -> left, 2 -> right */

void Servo_SweepStep(void)
{
    switch (sweep_state)
    {
        case 0: /* centre */
            Servo_SetAngle(SERVO_CENTER_ANGLE);

            Ultrasonic_StartMeasurement(US_POS_CENTER);

            sweep_state = 1;
            break;
        case 1: /* left */
            Servo_SetAngle(SERVO_LEFT_BOUNDARY);

            Ultrasonic_StartMeasurement(US_POS_LEFT);

            sweep_state = 2;
            break;
        default: /* right */
            Servo_SetAngle(SERVO_RIGHT_BOUNDARY);

            Ultrasonic_StartMeasurement(US_POS_RIGHT);

            sweep_state = 0;
            break;
    }
}
