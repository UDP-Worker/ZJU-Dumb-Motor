#include "servo.h"
#include "main.h"
#include "beep.h"
#include "ultrasonic.h"
#include "config.h"

extern TIM_HandleTypeDef htim5;

static uint16_t pwm_period = 0;

void Servo_Init(void)
{
    pwm_period = htim5.Init.Period;
    HAL_TIM_PWM_Start(&htim5, TIM_CHANNEL_1);
}

void Servo_SetAngle(float angle)
{
    /*
     * The mechanical installation of the servo used in the "Dumb-Motor"
     * project is such that 100° corresponds to the forward direction,
     * 180° is the extreme left and 20° is the extreme right.  Therefore
     * we remap the logical angle range [20°, 180°] to the PWM duty cycle
     * required by the servo.  The PWM generated by TIM5 has a period of
     * 20 ms (50 Hz) with a compare value of 249 giving ~0.5 ms pulse and
     * 1249 giving ~2.0 ms pulse.  We linearly map 20° to 0.5 ms and
     * 180° to 2.0 ms so that 100° becomes the new centre position.
     */

    if (angle < SERVO_RIGHT_BOUNDARY) angle = SERVO_RIGHT_BOUNDARY;
    if (angle > SERVO_LEFT_BOUNDARY)  angle = SERVO_LEFT_BOUNDARY;

    float scaled = (angle - SERVO_RIGHT_BOUNDARY) /
                   (SERVO_LEFT_BOUNDARY - SERVO_RIGHT_BOUNDARY);          /* 0.0 .. 1.0  */
    uint32_t compare = (uint32_t)(scaled * 1000.0f + 249.0f);
    __HAL_TIM_SET_COMPARE(&htim5, TIM_CHANNEL_1, compare);

}

static int8_t sweep_idx = -10;
static int8_t sweep_dir = 1;   /* 1 -> increasing, -1 -> decreasing */

void Servo_SweepStep(void)
{
    sweep_idx += sweep_dir;
    if(sweep_idx >= 10)
    {
        sweep_idx = 10;
        sweep_dir = -1;
    }
    else if(sweep_idx <= -10)
    {
        sweep_idx = -10;
        sweep_dir = 1;
    }

    float angle = 100.0f + sweep_idx * 8.0f;
    Servo_SetAngle(angle);
    us_idx = sweep_idx + 10;
    Ultrasonic_StartMeasurement();
}
